## esp32-s2-kaluga-1/examples/lvgl_demo/main/Kconfig.projbuild
```kconfig
menu "LCD Configuration"
  
    choice LCD_PAD_TYPE
       prompt "LCD pad type"
        default LCD_PAD_ESP32_S2_KALUGA_V1_3
        config LCD_PAD_ESP32_S2_KALUGA_V1_3
            bool "ESP32-S2-KALUGA_V1.3"
        config LCD_PAD_ESP32_S2_KALUGA_V1_2
            bool "ESP32-S2-KALUGA_V1.2"
        config LCD_PAD_ESP32_S2_KALUGA_V1_1
            bool "ESP32-S2-KALUGA_V1.1"
    endchoice

    choice LCD_VERSION

        prompt "LCD version"
        default LCD_ST7789
        config LCD_ST7789
            bool "ST7789"
        config LCD_ILI9341
            bool "ILI9341"
        help
            Set LCD version
    endchoice
        
endmenu

menu "Example Configuration"

    config ESP_WIFI_SSID
        string "WiFi SSID"
        default "myssid"
        help
            SSID (network name) for the example to connect to.

    config ESP_WIFI_PASSWORD
        string "WiFi Password"
        default "mypassword"
        help
            WiFi password (WPA or WPA2) for the example to use.

    config ESP_MAXIMUM_RETRY
        int "Maximum retry"
        default 5
        help
            Set the Maximum retry to avoid station reconnecting to the AP unlimited when the AP is really inexistent.
endmenu
```
